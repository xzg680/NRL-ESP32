## sdkconfig.defaults
```kconfig
CONFIG_FREERTOS_HZ=1000
# CONFIG_ESPTOOLPY_FLASHSIZE_2MB is not set
CONFIG_ESPTOOLPY_FLASHSIZE_16MB=y
CONFIG_ESPTOOLPY_FLASHSIZE="16MB"
# CONFIG_PARTITION_TABLE_SINGLE_APP is not set
CONFIG_PARTITION_TABLE_CUSTOM=y
CONFIG_PARTITION_TABLE_CUSTOM_FILENAME="part-gezipai.csv"
CONFIG_PARTITION_TABLE_FILENAME="part-gezipai.csv"
# --- Console ---
# Route stdio + ESP_LOG over the built-in USB-Serial-JTAG bridge so the host
# PC keeps seeing a CDC serial port (matches the prior ARDUINO_USB_MODE=1
# behaviour). src/lib/nrl_usb_console.cpp uses the same driver for AT-command
# I/O.
CONFIG_ESP_CONSOLE_USB_SERIAL_JTAG=y

# --- Main task stack ---
# IDF's default main-task stack (3584 B) is too small for our boot path:
# initApp() opens the WiFi/HTTPD/NimBLE/LVGL stacks back-to-back. Match
# arduino-esp32's old CONFIG_ARDUINO_LOOP_STACK_SIZE=8192 and a bit more.
CONFIG_ESP_MAIN_TASK_STACK_SIZE=16384

# --- Bluetooth (NimBLE host) ---
# Phase 3 of the Arduino-to-pure-IDF migration: src/lib/ble_config.cpp uses
# esp-nimble-cpp directly instead of arduino-esp32's Bluedroid-backed wrapper.
# Bluedroid and NimBLE are mutually exclusive; NimBLE is ~50KB smaller for the
# peripheral profile we need.
CONFIG_BT_ENABLED=y
CONFIG_BT_CONTROLLER_ENABLED=y
# CONFIG_BT_BLUEDROID_ENABLED is not set
CONFIG_BT_NIMBLE_ENABLED=y
CONFIG_BT_NIMBLE_ROLE_PERIPHERAL=y
CONFIG_BT_NIMBLE_ROLE_BROADCASTER=y
# CONFIG_BT_NIMBLE_ROLE_CENTRAL is not set
# CONFIG_BT_NIMBLE_ROLE_OBSERVER is not set
CONFIG_BT_NIMBLE_MAX_CONNECTIONS=1
CONFIG_BT_NIMBLE_PINNED_TO_CORE_0=y
# CONFIG_BT_BLE_50_FEATURES_SUPPORTED is not set
CONFIG_BT_BLE_42_FEATURES_SUPPORTED=y
CONFIG_BT_BLE_42_ADV_EN=y
CONFIG_BT_BLE_42_SCAN_EN=y
CONFIG_SPIRAM=y
CONFIG_SPIRAM_MODE_OCT=y
CONFIG_SPIRAM_SPEED_80M=y
CONFIG_SPIRAM_MALLOC_ALWAYSINTERNAL=512
CONFIG_SPIRAM_MALLOC_RESERVE_INTERNAL=65536
# CONFIG_SPIRAM_MEMTEST is not set
CONFIG_ESP_SR_MODEL_LOAD_FROM_PARTITION=y
CONFIG_ESP_SR_MODEL_PARTITION_NAME="model"
# CONFIG_SR_NSN_WEBRTC is not set
CONFIG_SR_NSN_NSNET2=y
# CONFIG_SR_WN_WN9_HILEXIN is not set
CONFIG_SR_MN_CN_NONE=y
# CONFIG_SR_MN_CN_MULTINET6_QUANT is not set
CONFIG_MBEDTLS_EXTERNAL_MEM_ALLOC=y
CONFIG_MBEDTLS_PSK_MODES=y
CONFIG_MBEDTLS_KEY_EXCHANGE_PSK=y
# CONFIG_ESP_DEFAULT_CPU_FREQ_MHZ_160 is not set
CONFIG_ESP_DEFAULT_CPU_FREQ_MHZ_240=y
CONFIG_ESP_DEFAULT_CPU_FREQ_MHZ=240
# CONFIG_ESP32S3_DEFAULT_CPU_FREQ_160 is not set
CONFIG_ESP32S3_DEFAULT_CPU_FREQ_240=y
CONFIG_ESP32S3_DEFAULT_CPU_FREQ_MHZ=240

# --- HTTP config portal ---
# Browser POSTs often carry User-Agent/Sec-Fetch/etc. headers larger than the
# IDF httpd defaults. Keep the portal tolerant of normal mobile/desktop
# browsers while still bounding parser buffers.
CONFIG_HTTPD_MAX_REQ_HDR_LEN=2048
CONFIG_HTTPD_MAX_URI_LEN=1024

# --- LVGL (格子派 ST7789 LCD UI; see src/app/driver/display.cpp) ---
# LVGL is vendored at components/lvgl and driven straight from the Arduino
# loop(), so it runs with no OS layer (LV_OS_NONE). These options configure
# LVGL through Kconfig (LV_CONF_SKIP=y, the default), so no lv_conf.h is used.
CONFIG_LV_COLOR_DEPTH_16=y
CONFIG_LV_OS_NONE=y
CONFIG_LV_USE_OS=0
CONFIG_LV_USE_CLIB_MALLOC=y
CONFIG_LV_USE_CLIB_STRING=y
CONFIG_LV_USE_CLIB_SPRINTF=y
CONFIG_LV_FONT_FMT_TXT_LARGE=y
# Montserrat sizes used by the UI: status bar (14), IP bar (16), SSID (20),
# clock (28) and the large caller callsign (48).
CONFIG_LV_FONT_MONTSERRAT_14=y
CONFIG_LV_FONT_MONTSERRAT_16=y
CONFIG_LV_FONT_MONTSERRAT_20=y
CONFIG_LV_FONT_MONTSERRAT_28=y
CONFIG_LV_FONT_MONTSERRAT_48=y
CONFIG_LV_FONT_DEFAULT_MONTSERRAT_14=y
CONFIG_LV_BUILD_EXAMPLES=n
CONFIG_LV_BUILD_DEMOS=n
```

## sdkconfig.defaults.esp32s3
```kconfig
# ESP32-S3-only defaults shared by gezipai and bh4tdv.

# --- PSRAM speed: 80 MHz (S3 octal PSRAM) ---
CONFIG_SPIRAM_SPEED_80M=y

# --- CPU speed: 240 MHz (S3 UI/audio headroom) ---
# CONFIG_ESP_DEFAULT_CPU_FREQ_MHZ_160 is not set
CONFIG_ESP_DEFAULT_CPU_FREQ_MHZ_240=y
CONFIG_ESP_DEFAULT_CPU_FREQ_MHZ=240

# --- Bluetooth (NimBLE host) ---
# Gezipai and BH4TDV use BLE provisioning through src/lib/ble_config.cpp.
# S31 overrides this with Bluedroid + Classic BT in sdkconfig.defaults.esp32s31.
CONFIG_BT_ENABLED=y
CONFIG_BT_CONTROLLER_ENABLED=y
# CONFIG_BT_BLUEDROID_ENABLED is not set
CONFIG_BT_NIMBLE_ENABLED=y
CONFIG_BT_NIMBLE_ROLE_PERIPHERAL=y
CONFIG_BT_NIMBLE_ROLE_BROADCASTER=y
# CONFIG_BT_NIMBLE_ROLE_CENTRAL is not set
# CONFIG_BT_NIMBLE_ROLE_OBSERVER is not set
CONFIG_BT_NIMBLE_MAX_CONNECTIONS=1
CONFIG_BT_NIMBLE_PINNED_TO_CORE_0=y
# CONFIG_BT_BLE_50_FEATURES_SUPPORTED is not set
CONFIG_BT_BLE_42_FEATURES_SUPPORTED=y
CONFIG_BT_BLE_42_ADV_EN=y
CONFIG_BT_BLE_42_SCAN_EN=y

# Keep Wi-Fi voice packets evenly spaced; throughput is not the bottleneck.
# CONFIG_ESP_WIFI_AMPDU_TX_ENABLED is not set
```
