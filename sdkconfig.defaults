## sdkconfig.defaults.esp32s31
```kconfig
# ESP32-S31-only overrides (auto-appended after sdkconfig.defaults by IDF).
# These reach the app build only; the 2nd-stage bootloader uses
# sdkconfig.bootloader.defaults, so none of this can boot-loop it.
#
# --- CPU speed: 320 MHz (ESP32-S31 default) ---
# The shared defaults keep S3-class boards at 240 MHz. S31 supports 320 MHz and
# its ESP-IDF Kconfig defaults to that speed, so override the shared setting here.
# CONFIG_ESP_DEFAULT_CPU_FREQ_MHZ_240 is not set
CONFIG_ESP_DEFAULT_CPU_FREQ_MHZ_320=y
CONFIG_ESP_DEFAULT_CPU_FREQ_MHZ=320

# --- PSRAM speed: 250 MHz (matches the official esp32-s31-korvo example) ---
# The RGB panel streams its framebuffer straight from PSRAM via GDMA with NO
# bounce buffer (display_s31.cpp). At the 200 MHz default the PSRAM can't feed the
# line FIFO fast enough and the image drifts from boot. 250 MHz provides the
# bandwidth headroom the panel needs. (The S31 PSRAM speed choice is 250/200/100/
# 40M; there is no 80M, so the shared sdkconfig.defaults' SPIRAM_SPEED_80M is
# ignored here.) NOTE: do NOT add CONFIG_SPIRAM_XIP_FROM_PSRAM -- XIP needs the
# bootloader to load flash into PSRAM and boot-loops on this board; 250 MHz alone
# does not. Because GDMA reads PSRAM directly (bypassing the CPU cache), this also
# makes the panel immune to the cache-disable during flash/codec writes, so the
# volume-change drift goes away too.
CONFIG_SPIRAM_SPEED_250M=y

# Flash auto-suspend: keep the cache alive during config-save flash writes so
# other CPU code (and any cached PSRAM access) isn't stalled. Harmless alongside
# the direct-GDBA panel path.
CONFIG_SPI_FLASH_AUTO_SUSPEND=y

# --- Console on UART0 (not USB-Serial-JTAG) ---
# The S31-Korvo's USB port is a Silicon Labs CP210x UART bridge wired to UART0,
# NOT the chip's native USB. The shared sdkconfig.defaults picks
# CONFIG_ESP_CONSOLE_USB_SERIAL_JTAG (correct for the S3 boards' native USB), but
# on this board that sends logs/AT to the unconnected USB-JTAG pins, so nothing
# shows up on COM. Route the console to UART0 so ESP_LOG + the AT console reach
# the CP210x (the same UART the ROM/bootloader already print on).
# CONFIG_ESP_CONSOLE_USB_SERIAL_JTAG is not set
CONFIG_ESP_CONSOLE_UART_DEFAULT=y

# --- Bluetooth: Classic BT + HFP Audio Gateway (for a BT headset) ---
# S31 has Classic BT in silicon (SOC_BT_CLASSIC_SUPPORTED). The shared
# sdkconfig.defaults selects the NimBLE host (BLE-only) for ble_config.cpp's BLE
# Wi-Fi provisioning, but HFP needs the Bluedroid host + Classic BT, and the two
# hosts are mutually exclusive. So S31 swaps to Bluedroid and drops BLE
# provisioning (it has the touchscreen config UI + SoftAP portal instead).
# ble_config.cpp and the esp-nimble-cpp component are compiled out for S31 (see
# src/lib/ble_config.cpp guard and src/CMakeLists.txt).
# CONFIG_BT_NIMBLE_ENABLED is not set
CONFIG_BT_BLUEDROID_ENABLED=y
# Controller in BR/EDR-only mode (Classic). Auto-enables BT_CTRL_BREDR_ENABLE.
CONFIG_BTDM_CTRL_MODE_BR_EDR_ONLY=y
# Allow one (e)SCO link for HFP voice -- the controller default is 0 (no audio).
CONFIG_BT_CTRL_BR_EDR_MAX_SYNC_CONN=1
# Single-headset device: we only ever use ONE peer link, so shrink the host
# link table (default 4) and the controller's ACL RX queue (default 6) -- each
# entry is internal RAM. MAX_ACL_CONN must stay at 2 though: dropping the
# controller to 1 ACL slot stopped the boot-time OOM but broke connecting
# entirely -- the page/inbound collision handling has no spare slot, so every
# connect returned HCI "Conn Limit Exceeded" (0x09) and no headset could link.
# 2 is the functional floor; the internal RAM it needs is freed by the Wi-Fi
# trims below (buffer pools + AMPDU off).
CONFIG_BT_CTRL_BR_EDR_MAX_ACL_CONN=2
CONFIG_BT_ACL_CONNECTIONS=2
CONFIG_BT_CTRL_BR_EDR_ACLU_RX_BUF_NB=4
# SCO/voice PCM travels over HCI so the app receives/sends it via data callbacks.
CONFIG_BT_CTRL_BR_EDR_SCO_DATA_PATH_HCI=y
# Bluedroid Classic profiles: HFP Audio Gateway (voice) + A2DP source
# (music to the headset; app-side SBC encoding via esp_audio_codec).
CONFIG_BT_CLASSIC_ENABLED=y
CONFIG_BT_A2DP_ENABLE=y
# A2DP SOURCE uses the app-encoded-SBC (external codec) model: nrl_bt_hfp.cpp
# encodes SBC via esp_sbc_enc and ships frames with esp_a2d_source_audio_data_send
# + esp_a2d_source_register_stream_endpoint. Those APIs REQUIRE this flag -- without
# it the endpoint register fails ("UNKNOWN ERROR"), which is why music never reached
# the BT headset. Enabling it also drops Bluedroid's internal SBC encoder (saves RAM).
CONFIG_BT_A2DP_USE_EXTERNAL_CODEC=y
CONFIG_BT_HFP_ENABLE=y
CONFIG_BT_HFP_AG_ENABLE=y
# CONFIG_BT_HFP_CLIENT_ENABLE is not set
# SCO audio over HCI (PCM frames delivered to the app), narrowband CVSD 8 kHz to
# match the project's 8 kHz G.711 pipeline (no resample); WBS 16 kHz left off.
CONFIG_BT_HFP_AUDIO_DATA_PATH_HCI=y
# CONFIG_BT_HFP_WBS_ENABLE is not set
# Bluedroid allocates its host workqueue and profile objects when the user turns
# BT on. The S31 UI/media build keeps internal RAM busy by then, so let BT move
# PSRAM-capable allocations out of internal RAM and keep the small internal
# blocks available for task/queue resources such as bt_workqueue.
CONFIG_BT_ALLOCATION_FROM_SPIRAM_FIRST=y
# The real bottleneck: this chip boots with only ~211 KB of internal DRAM, and by
# the time the user turns BT on the app is down to ~38 KB free / 29 KB largest
# block -- too little for Classic BT (the controller's mempool + Bluedroid's
# bt_workqueue, all FreeRTOS tasks/queues whose stacks MUST live in internal
# RAM), so startup fails and the stack aborts. BT_ALLOCATION_FROM_SPIRAM_FIRST
# alone doesn't help because the shortfall is internal-only resources.
# (SPIRAM_TRY_ALLOCATE_WIFI_LWIP was tried and made it WORSE: Wi-Fi's RX/TX DMA
# buffers can't live in PSRAM, so it hit "wifi:mem fail" and starved internal RAM
# down to <1 KB. Do not re-enable it.)
#
# Instead free internal RAM by trimming Wi-Fi's buffer pools. The app carries
# only low-bandwidth G.711 voice (UDP) plus config traffic, so the stock buffer
# counts are wildly oversized here; cutting them reclaims tens of KB of internal
# RAM for the BT stack with no audible effect on the voice path.
CONFIG_ESP_WIFI_STATIC_RX_BUFFER_NUM=4
CONFIG_ESP_WIFI_DYNAMIC_RX_BUFFER_NUM=8
CONFIG_ESP_WIFI_DYNAMIC_TX_BUFFER_NUM=8
CONFIG_ESP_WIFI_RX_MGMT_BUF_NUM_DEF=2
CONFIG_ESP_WIFI_MGMT_SBUF_NUM=8
# Keep AMPDU RX ON but with the smallest Block-Ack window (RX_BA_WIN=2 above).
# Turning aggregation fully OFF was tried and caused continuous WiFi stutter: the
# AP kept trying to set up Block-Ack and our side kept tearing it down
# ("[ADDBA] RX DELBA reason:37" churn), destabilising the voice link. Leaving RX
# aggregation on with a 2-deep window keeps the AP happy while holding only a
# tiny reorder buffer. TX aggregation stays off (we send only small voice frames,
# so TX A-MPDU buys nothing and its buffers are pure overhead here).
CONFIG_ESP_WIFI_AMPDU_RX_ENABLED=y
# CONFIG_ESP_WIFI_AMPDU_TX_ENABLED is not set

# --- LVGL SW-render stacks: 4 KB each (was 8 KB) to free internal RAM ---
# Two SW draw units (CONFIG_LV_DRAW_SW_DRAW_UNIT_CNT=2) each own a render thread
# whose stack is internal RAM. Measured peak use is <1 KB per thread
# (uxTaskGetStackHighWaterMark) -- FreeType is disabled so there is no deep
# glyph-render path -- so 8 KB each was ~14 KB of pure waste. 4 KB keeps ~3 KB
# margin and returns 8 KB of internal RAM for BT + concurrent music decode.
CONFIG_LV_DRAW_THREAD_STACK_SIZE=4096
# Wi-Fi/BT coexistence: UDP voice (Wi-Fi) and SCO (BT) share the single radio.
CONFIG_ESP_COEX_SW_COEXIST_ENABLE=y

# --- Give Bluetooth its own core (core 1); Wi-Fi + app stay on core 0 ---
# By default the Wi-Fi task, BT controller and Bluedroid host are ALL pinned to
# core 0 while core 1 sits idle. Core 0 then preempts the BT work two ways:
#   * the high-priority Wi-Fi task preempts the BT SCO data path while receiving
#     the downlink stream -> (e)SCO frame jitter heard as a continuous "warble"
#     (present only while a stream is active, clean once it stops; eSCO
#     retransmission can't fix it because it is CPU preemption, not RF loss);
#   * the app/lwIP tasks preempt the controller during connection setup ->
#     role-switch/LMP collisions and dropped links.
# Pinning the BT controller + Bluedroid host to the otherwise-idle core 1 gives
# Bluetooth a dedicated core: stable connections AND clean SCO, while Wi-Fi RX
# and the app keep core 0.
# CONFIG_BT_CTRL_PINNED_TO_CORE_CHOICE_0 is not set
CONFIG_BT_CTRL_PINNED_TO_CORE_CHOICE_1=y
# CONFIG_BT_BLUEDROID_PINNED_TO_CORE_0 is not set
CONFIG_BT_BLUEDROID_PINNED_TO_CORE_1=y

# --- Full CA certificate bundle (S31 only) ---
# Net radio / HLS sources sit behind assorted CDNs (observed: Ali CDN roots
# missing from the default "most common" subset -> TLS handshake fails).
# The S31's 7 MB app slots have room for the full bundle.
CONFIG_MBEDTLS_CERTIFICATE_BUNDLE_DEFAULT_FULL=y
# Radio-stream CDNs frequently serve incomplete chains (no intermediate
# cert), which mbedtls cannot repair. media_decoder retries such streams
# without verification (public audio; availability over authenticity).
# These options only permit that fallback path -- connections that attach
# the cert bundle still verify normally.
CONFIG_ESP_TLS_INSECURE=y
CONFIG_ESP_TLS_SKIP_SERVER_CERT_VERIFY=y

# --- Partition table: 7 MB app slots (S31 only) ---
# The media stack (MP3/AAC/FLAC decoder libs + esp-sr + LVGL + FreeType)
# outgrew part-gezipai.csv's 5 MB app partitions; part-s31.csv widens them
# to 7 MB and shrinks the oversized model partition (srmodels.bin ~330 KB).
CONFIG_PARTITION_TABLE_CUSTOM=y
CONFIG_PARTITION_TABLE_CUSTOM_FILENAME="part-s31.csv"
CONFIG_PARTITION_TABLE_FILENAME="part-s31.csv"

# --- Compiler optimization: -O2 (S31 only) ---
# The shared defaults inherit the legacy "default" (-Og debug) level; LVGL's
# software renderer and the audio decoders are 2-3x slower there, which reads
# directly as UI latency on the 800x480 panel.
CONFIG_COMPILER_OPTIMIZATION_PERF=y

# --- FreeRTOS runtime stats (S31 only) ---
# Powers the top-bar per-core CPU load readout and the AT+TOP per-task CPU
# list used to hunt UI-latency regressions on this board.
CONFIG_FREERTOS_GENERATE_RUN_TIME_STATS=y
CONFIG_FREERTOS_USE_TRACE_FACILITY=y
CONFIG_FREERTOS_VTASKLIST_INCLUDE_COREID=y

# --- LVGL parallel software rendering (S31 only) ---
# A full-screen render of the 800x480 UI costs ~280 ms single-threaded while
# core 1 sits idle; two SW draw units split the dirty areas across worker
# threads (FreeRTOS scheduler puts the second one on core 1), roughly
# halving page-transition latency. Thread priority 6 keeps the workers
# above the poll loop (5) so the render they gate is never starved.
CONFIG_LV_OS_FREERTOS=y
CONFIG_LV_DRAW_SW_DRAW_UNIT_CNT=2
CONFIG_LV_DRAW_THREAD_PRIO=6

# --- LVGL FreeType binding: disabled (S31) ---
# The FreeType vector CJK engine was a comparison experiment (AT+FONT=FT);
# in practice the bitmap GB2312 subset is what renders (no TTF on card).
# FreeType would force 32 KB stacks on BOTH parallel draw threads (64 KB of
# scarce internal RAM), so it yields to dual-core rendering. Re-enable by
# restoring CONFIG_LV_USE_FREETYPE=y + CONFIG_LV_FREETYPE_CACHE_FT_GLYPH_CNT
# and bumping CONFIG_LV_DRAW_THREAD_STACK_SIZE to 32768.
# CONFIG_LV_USE_FREETYPE is not set

# --- FatFs filename encoding (TF card / USB drive music library) ---
# Default ANSI/OEM (CP437) cannot represent Chinese long filenames: readdir
# falls back to the 8.3 short alias (".flac" -> ".FLA") and the playlist
# scanner skips the file. The UTF-8 API returns the LFN verbatim, which also
# feeds the CJK-capable music UI font directly.
CONFIG_FATFS_API_ENCODING_UTF_8=y

# --- DVP camera sensor (video call, S31 only) ---
# The Korvo board's OV3660 must be enabled explicitly or esp-video registers
# no sensor and /dev/video2 never appears (bsp_camera_open fails). The only
# JPEG mode this sensor offers over DVP is 1280x720@12fps with a 10 MHz
# XCLK; video_call.cpp requests exactly that.
CONFIG_CAMERA_OV3660=y
CONFIG_CAMERA_OV3660_DVP_JPEG_1280X720_12FPS=y
CONFIG_CAMERA_OV3660_DVP_DEFAULT_FMT_JPEG_1280X720_12FPS=y
```
